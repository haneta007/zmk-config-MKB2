## Kconfig
```kconfig
config MKB_POINTER_ACCELERATION
    bool "MKB pointer acceleration input processor"
    default y
    depends on ZMK_POINTING
    depends on DT_HAS_HANETA007_INPUT_PROCESSOR_POINTER_ACCELERATION_ENABLED
    help
      Scale small and large physical pointer movements differently while
      preserving normal-speed movement.
```

## dts/bindings/input_processors/haneta007,input-processor-pointer-acceleration.yaml
```yaml
description: Input processor for piecewise pointer acceleration

compatible: "haneta007,input-processor-pointer-acceleration"

include: ip_zero_param.yaml

properties:
  type:
    type: int
    required: true
  codes:
    type: array
    required: true
  slow-threshold:
    type: int
    required: true
    description: Maximum absolute input count scaled with the slow ratio
  fast-threshold:
    type: int
    required: true
    description: Minimum absolute input count scaled with the fast ratio
  slow-multiplier:
    type: int
    required: true
  slow-divisor:
    type: int
    required: true
  fast-multiplier:
    type: int
    required: true
  fast-divisor:
    type: int
    required: true
```
